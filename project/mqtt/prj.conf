## CMakeLists.txt
```
#
# Copyright (c) 2023 Nordic Semiconductor ASA
#
# SPDX-License-Identifier: LicenseRef-Nordic-5-Clause
#

cmake_minimum_required(VERSION 3.20.0)

find_package(Zephyr REQUIRED HINTS $ENV{ZEPHYR_BASE})
project(mqtt)

target_sources(app PRIVATE src/main.c src/relays.c src/power.c)

# Include files that are common for all modules
add_subdirectory(src/common)

# Include mandatory module source folders
add_subdirectory(src/modules/trigger)
add_subdirectory(src/modules/sampler)
add_subdirectory(src/modules/network)
add_subdirectory(src/modules/transport)
add_subdirectory(src/modules/error)

# Optional modules
add_subdirectory_ifdef(CONFIG_MQTT_SAMPLE_LED src/modules/led)
```

## prj.conf
```kconfig
#
# Copyright (c) 2023 Nordic Semiconductor ASA
#
# SPDX-License-Identifier: LicenseRef-Nordic-5-Clause
#

# Common configurations for all boards

# General
CONFIG_HW_ID_LIBRARY=y
CONFIG_ASSERT=y

# ADC
CONFIG_ADC=y

# Logging
CONFIG_LOG=y

# Networking
CONFIG_NETWORKING=y
CONFIG_NET_SOCKETS_OFFLOAD=y
CONFIG_NET_SOCKETS=y
CONFIG_POSIX_API=y
CONFIG_NET_IPV4=y
CONFIG_NET_TCP=y
CONFIG_NET_NATIVE=y
CONFIG_NET_CONNECTION_MANAGER=y
CONFIG_DNS_RESOLVER=y

# ZBus
CONFIG_ZBUS=y

# Zephyr state framework
CONFIG_SMF=y

# MQTT (raw Zephyr MQTT client)
CONFIG_MQTT_LIB=y
CONFIG_MQTT_LIB_TLS=y
CONFIG_MQTT_KEEPALIVE=300
CONFIG_MQTT_CLEAN_SESSION=y

# TLS credentials
CONFIG_MODEM_KEY_MGMT=y
CONFIG_MQTT_SAMPLE_TRANSPORT_SEC_TAG=955

# Broker
CONFIG_MQTT_SAMPLE_TRANSPORT_BROKER_HOSTNAME="***REMOVED***.s1.eu.hivemq.cloud"
CONFIG_MQTT_SAMPLE_TRANSPORT_BROKER_USERNAME="device1"
CONFIG_MQTT_SAMPLE_TRANSPORT_BROKER_PASSWORD="***REMOVED***"

# JSON
CONFIG_CJSON_LIB=y

# Timestamp
CONFIG_DATE_TIME=y
CONFIG_DATE_TIME_AUTO_UPDATE=y

# AT monitor heap for modem notifications (%XTIME etc.)
CONFIG_AT_MONITOR_HEAP_SIZE=512

# Payload buffer size (JSON state)
CONFIG_MQTT_SAMPLE_PAYLOAD_CHANNEL_STRING_MAX_SIZE=256

# TF-M
CONFIG_TFM_PROFILE_TYPE_MINIMAL=y

# General
CONFIG_HW_STACK_PROTECTION=y
CONFIG_HW_ID_LIBRARY_SOURCE_IMEI=y
CONFIG_PICOLIBC=y
CONFIG_DK_LIBRARY=y

# Shell
CONFIG_SHELL=y
CONFIG_SHELL_BACKEND_SERIAL=y

# Modem trace
CONFIG_NRF_MODEM_LIB_TRACE=n


# LED
CONFIG_MQTT_SAMPLE_LED=n

# Disable Duplicate Address Detection (DAD)
# due to not being properly implemented for offloaded interfaces.
CONFIG_NET_IPV6_NBR_CACHE=n
CONFIG_NET_IPV6_MLD=n

# Zephyr NET Connection Manager and Connectivity layer.
CONFIG_NET_CONNECTION_MANAGER_MONITOR_STACK_SIZE=1024
CONFIG_NRF_MODEM_LIB_NET_IF=y
```

## boards/nrf9151_connectkit_nrf9151_ns.conf
```kconfig
#
# Copyright (c) 2024 Nordic Semiconductor ASA
#
# SPDX-License-Identifier: LicenseRef-Nordic-5-Clause
#

# Configuration file for nRF9151 DK
# This file is merged with prj.conf in the application folder, and options
# set here will take precedence if they are present in both files.

# TF-M
CONFIG_TFM_PROFILE_TYPE_MINIMAL=y

# General
CONFIG_HW_STACK_PROTECTION=y
CONFIG_HW_ID_LIBRARY_SOURCE_IMEI=y
CONFIG_PICOLIBC=y
CONFIG_DK_LIBRARY=y
# CONFIG_AT_HOST_LIBRARY=y

# Modem trace
CONFIG_NRF_MODEM_LIB_TRACE=n

# LED
CONFIG_MQTT_SAMPLE_LED=n

# Disable Duplicate Address Detection (DAD)
# due to not being properly implemented for offloaded interfaces.
CONFIG_NET_IPV6_NBR_CACHE=n
CONFIG_NET_IPV6_MLD=n

# Zephyr NET Connection Manager and Connectivity layer.
CONFIG_NET_CONNECTION_MANAGER_MONITOR_STACK_SIZE=1024
CONFIG_NRF_MODEM_LIB_NET_IF=y
```

## src/main.c
```c
#include <zephyr/kernel.h>
#include <zephyr/logging/log.h>
#include <zephyr/zbus/zbus.h>

#include "message_channel.h"
#include "relays.h"
#include "power.h"

LOG_MODULE_REGISTER(main, LOG_LEVEL_INF);

ZBUS_SUBSCRIBER_DEFINE(main_sub, 4);
ZBUS_CHAN_ADD_OBS(NETWORK_CHAN, main_sub, 0);

int main(void)
{
	const struct zbus_channel *chan;
	enum network_status status;

	LOG_INF("Hello world!");

	relays_init();
	power_init();

	/* Test: read ADC channels */
	int32_t battery_mv, current_mv;

	for (int i = 0; i < 5; i++) {
		if (!power_read_battery_mv(&battery_mv)) {
			LOG_INF("Battery: %d mV", battery_mv);
		}
		if (!power_read_current_ma(&current_mv)) {
			LOG_INF("Current sense: %d mV", current_mv);
		}
		k_sleep(K_SECONDS(2));
	}

	/* Test: cycle through each relay */
	for (int i = 0; i < NUM_RELAYS; i++) {
		LOG_INF("Relay %d ON", i);
		relay_set(i, true);
		k_sleep(K_SECONDS(2));
		LOG_INF("Relay %d OFF", i);
		relay_set(i, false);
		k_sleep(K_SECONDS(1));
	}

	LOG_INF("All relays ON");
	relays_set_all(0x1F);
	k_sleep(K_SECONDS(3));
	LOG_INF("All relays OFF");
	relays_set_all(0x00);

	/* Wait for network connected event */
	while (!zbus_sub_wait(&main_sub, &chan, K_FOREVER)) {
		if (chan == &NETWORK_CHAN) {
			zbus_chan_read(&NETWORK_CHAN, &status, K_SECONDS(1));
			if (status == NETWORK_CONNECTED) {
				break;
			}
		}
	}

	/* Wait for MQTT connection to be established */
	k_sleep(K_SECONDS(15));

	struct payload payload = { 0 };

	snprintk(payload.string, sizeof(payload.string), "Hello World");

	int err = zbus_chan_pub(&PAYLOAD_CHAN, &payload, K_SECONDS(1));
	if (err) {
		LOG_ERR("Failed to publish: %d", err);
	} else {
		LOG_INF("Hello World sent");
	}

	return 0;
}
```

## src/power.c
```c
#include <zephyr/kernel.h>
#include <zephyr/drivers/adc.h>
#include <zephyr/logging/log.h>

#include "power.h"

LOG_MODULE_REGISTER(power, LOG_LEVEL_INF);

#define ZEPHYR_USER DT_PATH(zephyr_user)

static const struct adc_dt_spec adc_current = ADC_DT_SPEC_GET_BY_IDX(ZEPHYR_USER, 0);
static const struct adc_dt_spec adc_battery = ADC_DT_SPEC_GET_BY_IDX(ZEPHYR_USER, 1);

static int16_t sample_buf;

static struct adc_sequence sequence = {
	.buffer = &sample_buf,
	.buffer_size = sizeof(sample_buf),
};

int power_init(void)
{
	int err;

	if (!adc_is_ready_dt(&adc_current)) {
		LOG_ERR("ADC current channel not ready");
		return -ENODEV;
	}

	if (!adc_is_ready_dt(&adc_battery)) {
		LOG_ERR("ADC battery channel not ready");
		return -ENODEV;
	}

	err = adc_channel_setup_dt(&adc_current);
	if (err) {
		LOG_ERR("ADC current channel setup failed: %d", err);
		return err;
	}

	err = adc_channel_setup_dt(&adc_battery);
	if (err) {
		LOG_ERR("ADC battery channel setup failed: %d", err);
		return err;
	}

	LOG_INF("Power ADC initialized");
	return 0;
}

static int read_channel_mv(const struct adc_dt_spec *spec, int32_t *millivolts)
{
	int err;

	err = adc_sequence_init_dt(spec, &sequence);
	if (err) {
		return err;
	}

	err = adc_read_dt(spec, &sequence);
	if (err) {
		return err;
	}

	*millivolts = (int32_t)sample_buf;
	err = adc_raw_to_millivolts_dt(spec, millivolts);
	if (err) {
		/* If conversion not supported, return raw value */
		*millivolts = (int32_t)sample_buf;
	}

	return 0;
}

int power_read_battery_mv(int32_t *millivolts)
{
	return read_channel_mv(&adc_battery, millivolts);
}

int power_read_current_ma(int32_t *milliamps)
{
	return read_channel_mv(&adc_current, milliamps);
}
```

## src/power.h
```c
#ifndef _POWER_H_
#define _POWER_H_

#include <stdint.h>

int power_init(void);
int power_read_battery_mv(int32_t *millivolts);
int power_read_current_ma(int32_t *milliamps);

#endif /* _POWER_H_ */
```

## src/relays.c
```c
#include <zephyr/kernel.h>
#include <zephyr/drivers/gpio.h>
#include <zephyr/logging/log.h>

#include "relays.h"

LOG_MODULE_REGISTER(relays, LOG_LEVEL_INF);

static const struct gpio_dt_spec relays[NUM_RELAYS] = {
	GPIO_DT_SPEC_GET(DT_ALIAS(relay0), gpios),
	GPIO_DT_SPEC_GET(DT_ALIAS(relay1), gpios),
	GPIO_DT_SPEC_GET(DT_ALIAS(relay2), gpios),
	GPIO_DT_SPEC_GET(DT_ALIAS(relay3), gpios),
	GPIO_DT_SPEC_GET(DT_ALIAS(relay4), gpios),
};

int relays_init(void)
{
	for (int i = 0; i < NUM_RELAYS; i++) {
		if (!gpio_is_ready_dt(&relays[i])) {
			LOG_ERR("Relay %d GPIO not ready", i);
			return -ENODEV;
		}
		int err = gpio_pin_configure_dt(&relays[i], GPIO_OUTPUT_INACTIVE);
		if (err) {
			LOG_ERR("Failed to configure relay %d: %d", i, err);
			return err;
		}
	}

	LOG_INF("Relays initialized");
	return 0;
}

int relay_set(uint8_t idx, bool on)
{
	if (idx >= NUM_RELAYS) {
		return -EINVAL;
	}
	return gpio_pin_set_dt(&relays[idx], on);
}

bool relay_get(uint8_t idx)
{
	if (idx >= NUM_RELAYS) {
		return false;
	}
	return gpio_pin_get_dt(&relays[idx]);
}

int relays_set_all(uint8_t mask)
{
	for (int i = 0; i < NUM_RELAYS; i++) {
		int err = gpio_pin_set_dt(&relays[i], (mask >> i) & 1);
		if (err) {
			return err;
		}
	}
	return 0;
}
```

## src/relays.h
```c
#ifndef _RELAYS_H_
#define _RELAYS_H_

#include <zephyr/drivers/gpio.h>

#define NUM_RELAYS 5

int relays_init(void);
int relay_set(uint8_t idx, bool on);
bool relay_get(uint8_t idx);
int relays_set_all(uint8_t mask);

#endif /* _RELAYS_H_ */
```
