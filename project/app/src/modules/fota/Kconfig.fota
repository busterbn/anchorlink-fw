## project/app/src/modules/fota/Kconfig.fota
```kconfig
config APP_FOTA_CHECK_INTERVAL_MINUTES
	int "Periodic FOTA check interval in minutes (0 = only boot + fota_update command)"
	default 0
	help
	  How often the device polls Memfault for a new firmware release, on top
	  of the check at boot and on an MQTT "fota_update" command. 0 disables
	  periodic checks. A non-zero value is a safety net so a remote device can
	  always pick up a recovery build even if MQTT is wedged.
```

## project/app/src/modules/transport/Kconfig.transport
```kconfig
#
# Copyright (c) 2023 Nordic Semiconductor
#
# SPDX-License-Identifier: LicenseRef-Nordic-5-Clause
#

menu "Transport"
	depends on MQTT_LIB
	depends on HW_ID_LIBRARY

config MQTT_SAMPLE_TRANSPORT_RECONNECTION_TIMEOUT_SECONDS
	int "Reconnection timeout in seconds"
	default 60

config MQTT_SAMPLE_TRANSPORT_THREAD_STACK_SIZE
	int "Thread stack size"
	default 4096

config MQTT_SAMPLE_TRANSPORT_MESSAGE_QUEUE_SIZE
	int "Message queue size"
	default 5

config MQTT_SAMPLE_TRANSPORT_WORKQUEUE_STACK_SIZE
	int "Workqueue stack size"
	default 4096

config MQTT_SAMPLE_TRANSPORT_BROKER_HOSTNAME
	string "MQTT broker hostname"
	default "test.mosquitto.org"

config MQTT_SAMPLE_TRANSPORT_BROKER_PORT
	int "MQTT broker port"
	default 8883

config MQTT_SAMPLE_TRANSPORT_BROKER_USERNAME
	string "MQTT broker username"

config MQTT_SAMPLE_TRANSPORT_BROKER_PASSWORD
	string "MQTT broker password"

config MQTT_SAMPLE_TRANSPORT_SEC_TAG
	int "TLS security tag"
	default 955
	help
	  Security tag for TLS credentials in the modem key store.

config MQTT_SAMPLE_TRANSPORT_CLIENT_ID
	string "MQTT Client ID"
	default ""
	help
	  Use a custom client ID string. If not set, the client ID will default to the
	  modem's IMEI number for nRF91 Series devices.

config MQTT_SAMPLE_TRANSPORT_CLIENT_ID_BUFFER_SIZE
	int "MQTT Client ID buffer size"
	default 50

config MQTT_SAMPLE_TRANSPORT_RX_TX_BUFFER_SIZE
	int "MQTT RX/TX buffer size"
	default 512

module = MQTT_SAMPLE_TRANSPORT
module-str = Transport
source "subsys/logging/Kconfig.template.log_config"

endmenu # Transport
```

## project/boards/seahub_v1/Kconfig.seahub_v1
```kconfig
# SeaHub V1 board configuration

# Copyright (c) 2016-2025 Makerdiary <https://makerdiary.com>
# SPDX-License-Identifier: Apache-2.0

config BOARD_SEAHUB_V1
	select SOC_NRF52820_QDAA if BOARD_SEAHUB_V1_NRF52820
	select SOC_NRF9151_LACA if BOARD_SEAHUB_V1_NRF9151 || BOARD_SEAHUB_V1_NRF9151_NS
```

## project/boards/seahub_v1/board.yml
```yaml
board:
  name: seahub_v1
  vendor: makerdiary
  socs:
    - name: nrf52820
    - name: nrf9151
      variants:
        - name: 'ns'
```

## project/drivers/led/Kconfig.lp5817
```kconfig
# Copyright (c) 2025, My Company
# SPDX-License-Identifier: Apache-2.0

config LED_LP5817
	bool "TI LP5817 LED driver"
	default y
	depends on I2C
	select LED_TRIGGER
	help
	  Enable the driver for the TI LP5817 3-channel I2C LED driver.
```

## project/dts/bindings/led/ti,lp5817.yaml
```yaml
# Copyright (c) 2025, My Company
# SPDX-License-Identifier: Apache-2.0

description: TI LP5817 3-Channel I2C RGB LED Driver

compatible: "ti,lp5817"

include: [i2c-device.yaml, led-controller.yaml]

properties:
  max-current-ma:
    type: int
    required: false
    default: 25
    description: |
      Sets the maximum output current for all channels.
      The LP5817 supports two ranges:
      - 25: For the 25.5mA range
      - 51: For the 51mA range

child-binding:
  description: LP5817 child LED node
  properties:
    label:
      type: string
      required: true
      description: The user-visible name for this LED.
    color:
      type: int
      required: false
      description: |
        The color of the LED, from the list of predefined LED_COLOR_ID_*
        values in <dt-bindings/led/led.h>.
```
